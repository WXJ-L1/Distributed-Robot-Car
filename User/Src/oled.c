//
// Created wxj on 26-4-8.
//

#include "oled.h"
#include "i2c.h"
#include <string.h>

// ================= 硬件配置 =================
#define OLED_ADDRESS (0x3C << 1)
#define OLED_PAGE   8
#define OLED_ROW    64
#define OLED_COLUMN 128

// 显存
uint8_t OLED_GRAM[OLED_PAGE][OLED_COLUMN];

// ================= 底层I2C =================
void OLED_SendCmd(uint8_t cmd)
{
    uint8_t buf[2];
    buf[0] = 0x00;
    buf[1] = cmd;
    HAL_I2C_Master_Transmit(&hi2c2, OLED_ADDRESS, buf, 2, HAL_MAX_DELAY);
}

void OLED_SendData(uint8_t *data, uint16_t size)
{
    uint8_t buf[129];
    buf[0] = 0x40;

    for (uint16_t i = 0; i < size; i++)
        buf[i + 1] = data[i];

    HAL_I2C_Master_Transmit(&hi2c2, OLED_ADDRESS, buf, size + 1, HAL_MAX_DELAY);
}

// ================= 初始化 =================
void OLED_Init(void)
{
    HAL_Delay(100);
    OLED_SendCmd(0xAE);
    OLED_SendCmd(0x20); OLED_SendCmd(0x10);
    OLED_SendCmd(0xB0);
    OLED_SendCmd(0xC8);
    OLED_SendCmd(0x00);
    OLED_SendCmd(0x10);
    OLED_SendCmd(0x40);
    OLED_SendCmd(0x81); OLED_SendCmd(0xFF);
    OLED_SendCmd(0xA1);
    OLED_SendCmd(0xA6);
    OLED_SendCmd(0xA8); OLED_SendCmd(0x3F);
    OLED_SendCmd(0xA4);
    OLED_SendCmd(0xD3); OLED_SendCmd(0x00);
    OLED_SendCmd(0xD5); OLED_SendCmd(0xF0);
    OLED_SendCmd(0xD9); OLED_SendCmd(0x22);
    OLED_SendCmd(0xDA); OLED_SendCmd(0x12);
    OLED_SendCmd(0xDB); OLED_SendCmd(0x20);
    OLED_SendCmd(0x8D); OLED_SendCmd(0x14);
    OLED_SendCmd(0xAF);
}

void OLED_NewFrame(void)
{
    memset(OLED_GRAM, 0, sizeof(OLED_GRAM));
}

void OLED_ShowFrame(void)
{
    for (uint8_t page = 0; page < OLED_PAGE; page++)
    {
        OLED_SendCmd(0xB0 + page);
        OLED_SendCmd(0x00);
        OLED_SendCmd(0x10);

        OLED_SendData(OLED_GRAM[page], OLED_COLUMN);
    }
}

void OLED_SetPixel(uint8_t x, uint8_t y)
{
    if (x >= OLED_COLUMN || y >= OLED_ROW) return;
    OLED_GRAM[y / 8][x] |= (1 << (y % 8));
}

// ================= 字体 (6x8 ASCII) =================
const uint8_t Font6x8[][6] = {
    {0x00,0x00,0x00,0x00,0x00,0x00}, // space 32
    {0x00,0x00,0x5F,0x00,0x00,0x00}, //! 33
    {0x00,0x07,0x00,0x07,0x00,0x00}, //" 34
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    {0x61,0x51,0x49,0x45,0x43,0x00}, //Z 90
};

void OLED_ShowChar(uint8_t x, uint8_t y, char c)
{
    // 边界检查
    if (x >= OLED_COLUMN - 6 || y >= OLED_PAGE) return;

    if (c < ' ' || c > 'Z') c = ' ';

    uint8_t index = c - ' ';

    for (uint8_t i = 0; i < 6; i++)
    {
        OLED_GRAM[y][x + i] = Font6x8[index][i];
    }
}

void OLED_ShowString(uint8_t x, uint8_t y, char *str)
{
    while (*str)
    {
        OLED_ShowChar(x, y, *str);
        x += 6;
        if (x >= OLED_COLUMN - 6) break;
        str++;
    }
}